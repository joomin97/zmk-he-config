## boards/shields/myhe/Kconfig.defconfig
```kconfig
if SHIELD_MYHE

config ZMK_KEYBOARD_NAME
    default "MYHE"

config INPUT
    default y

config ZMK_USB
    default y

endif
```

## boards/shields/myhe/Kconfig.shield
```kconfig
# Copyright (c) 2025 Joomin97
# SPDX-License-Identifier: MIT

config SHIELD_MYHE
    def_bool $(shields_list_contains,myhe)
    
```

## boards/shields/myhe/myhe.defconfig
```kconfig
# Copyright (c) 2025 Joomin97
# SPDX-License-Identifier: MIT

CONFIG_SHIELD_MYHE_LEFT=y
CONFIG_SHIELD_MYHE_RIGHT=y
```
